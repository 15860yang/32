/*************************************DoWell电子******************************************************
@文件名    : NRF24L01发送.c
@描述		   : 主函数文件，发送程序
@实验平台  : nRF24l01无线模块+STC89C52最小系统板（带有nRF24L01模块接口）
****************************************************************************************************/
#include <stdio.h>
#include <string.h>
#include <reg52.h>
#include "NRF24L01.h"
#include "Usart_Config.h"
#include "Type_Define.h"
#include "XPT2046.h"	

typedef unsigned int u16;	  //对数据类型进行声明定义
typedef unsigned char u8;
#define uchar unsigned char
#define uint unsigned int

//************************************LED***************************************************
sbit  LED1  = P2^0;	 //定义单片机P2口的第1位 （即P2.0）为指示端
sbit  LED3	= P2^2;	 //定义单片机P2口的第3位 （即P2.2）为指示端
sbit  LED8  = P2^7;	 //用于指示数据发送状态，在测试24L01时使用
sbit  LED2  = P2^1;	


sbit  DOUT1 = P1^0;	 //定义单片机P1口的第1位 （即P1.0）为传感器的输入端
sbit  DOUT2 = P1^5;	 //定义单片机P1口的第2位 （即P1.1）为传感器的输入端


sbit k1=P3^1;	 //定义P31口是k1
/********************************************************************************
@函数名称:	Delay_ms()
@描述：			普通延时函数，当z等于1时大概1ms
@输入：			无
@输出：			无
@返回：			无
@注意事项：	无
********************************************************************************/
void delay_ms(uint z)
{
  uint x,y;
	for(x = 0;x < z;x++)
	  for(y = 0;y < 110;y++);
}

/*******************************************************************************
* 函数名         :datapros()
* 函数功能		 :数据处理函数
* 输入           : 无
* 输出         	 : 无
*******************************************************************************/
uint datapros1(){
	uint temp = (Read_AD_Data(0xA4)/4);		//   AIN2 光敏电阻
	return temp;	
}

uint datapros2(){
	uint temp = (Read_AD_Data(0xE4)/12);		//   AIN3 外部输入
	return temp;	
}

/********************************************************************************
@函数名称:	Mode()
@描述：			操作模式 自动模式，约每2秒发送一次数据
@输入：			无
@输出：			无
@返回：			无
@注意事项：	无
********************************************************************************/

void Mode(uint light,uint rain ,uint d)								 
{							
	//按照次序分别是光强，雨量，有无烟雾，有无火
	char template[] = "%d#%d#%d#";

	uchar Display_Buff[32];
	sprintf(Display_Buff,template,light,rain,d);
	NRF24L01_TxPacket(Display_Buff);	         // 发送	TxBuf 中的数据

	LED8=0;										 // 点亮LED以做提示
}
/********************************************************************************
@函数名称:	main()
@描述：			主函数
@输入：			无
@输出：			无
@返回：			无
@注意事项：	无
********************************************************************************/
void main(void){								  
	uint data1;
	uint data2;
	uint d = 0;
	Init_NRF24L01();//初始化24L01
	delay_ms(100);
	while(1){
		LED8=0;	
		LED1=1;
		LED3=1;
		if(DOUT1==0)//当火焰高于设定值时 ，执行条件函数
		{
		 	delay_ms(10);//延时抗干扰
			if(DOUT1==0)//确定火焰高于设定值时 ，执行条件函数
			{
			 	LED1=0;	   //点亮P2.0口灯
				d |= 0x00000001;
			 	delay_ms(200);
			}else d &= 254;
		}else d &= 254;
		if(DOUT2==0)//当烟雾浓度浓度高于设定值时 ，执行条件函数
		{
		 	delay_ms(10);//延时抗干扰
			if(DOUT2==0)//确定烟雾浓度浓度高于设定值时 ，执行条件函数
			{
			 	LED3=0;	   //点亮P2.2口灯
				d |= 0x00000002;
			 	delay_ms(200);
			} else d &= 253;
		} else d &= 253;
		 
		if(k1==0)		  //检测按键K1是否按下
		{	
			delay_ms(10);   //消除抖动 一般大约10ms
			if(k1==0)	 //再次判断按键是否按下
			{
				d |= 4;
				LED2 = 0;	  //led状态取反
			} else {
				d &= 251;
				LED2 = 1;
			}
		} else {
		   	d &= 251;
			LED2 = 1;
		}
		data1 = datapros1();	//数据处理函数
		data2 = datapros2();
		Mode(data1,data2,d);		//自动发送数据
		LED8=1;				//发完一次熄灭LED以做提示
		delay_ms(200);
	}	
}
